## app/Kconfig
```kconfig
config APP_HEARTBEAT_PERIOD_MS
    int "App Heartbeat Period (ms)"
    default 500
    range 100 2000

source "Kconfig.zephyr" # need this line so that it looks a the rest of the default zephyr config after your custom code above
```
